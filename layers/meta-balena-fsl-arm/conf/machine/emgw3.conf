## layers/meta-balena-fsl-arm/conf/machine/emgw3.conf
```bitbake
#@TYPE: Machine
#@NAME: EM GW 3
#@SOC: i.MX8 MM
#@DESCRIPTION: Machine configuration for Boundary EM GW 3

MACHINEOVERRIDES =. "nitrogen8mm:"

include conf/machine/nitrogen8mm.conf

# Kernel configuration
KERNEL_DEVICETREE = " \
	freescale/imx8mm-em.dtb \
"

# Override default Nitrogen8MM u-boot configuration
UBOOT_DTB_NAME = "imx8mm-em.dtb"
UBOOT_CONFIG = "emgw3"
UBOOT_CONFIG[emgw3] = "em_2gr0_defconfig,sdcard"
```

## layers/meta-balena-fsl-arm/conf/machine/nitrogen6xq2g.conf
```bitbake
MACHINEOVERRIDES =. "nitrogen6x:"

include conf/machine/include/imx-base.inc
include conf/machine/include/tune-cortexa9.inc

KERNEL_IMAGETYPE = "zImage"

PREFERRED_PROVIDER_u-boot = "u-boot-boundary"
PREFERRED_PROVIDER_virtual/bootloader = "u-boot-boundary"
PREFERRED_PROVIDER_virtual/kernel = "linux-boundary"

SERIAL_CONSOLE = "115200 ttymxc1"

MACHINE_ESSENTIAL_EXTRA_RDEPENDS:remove = " kernel-image"
UBOOT_MACHINE = "nitrogen6q2g_defconfig"

KERNEL_DEVICETREE = "imx6q-sabrelite.dtb \
                        imx6q-nitrogen6_max.dtb imx6qp-nitrogen6_max.dtb \
                        imx6q-nitrogen6x.dtb imx6dl-nitrogen6x.dtb \
                        imx6q-nitrogen6_som2.dtb imx6qp-nitrogen6_som2.dtb \
                        imx6dl-nitrogen6_vm.dtb imx6dl-nitrogen6_vm-magstripe.dtb \
"

MACHINE_EXTRA_RRECOMMENDS:append = " \
                               mtd-utils \
                               u-boot-flasher \
"

MACHINE_ESSENTIAL_EXTRA_RDEPENDS:append = " \
    kernel-devicetree \
    mtd-utils \
    u-boot-flasher \
"
```

## layers/meta-balena-fsl-arm/conf/machine/nitrogen8mm-dwe.conf
```bitbake
#@TYPE: Machine
#@NAME: Boundary Devices Nitrogen8MM DWE
#@SOC: i.MX8 MQ
#@DESCRIPTION: Machine configuration for Boundary Devices Nitrogen8MM DWE

MACHINEOVERRIDES = "nitrogen8mm:${MACHINE}"

include conf/machine/nitrogen8mm.conf

# Kernel configuration
KERNEL_DEVICETREE = " \
	freescale/imx8mm-dwe.dtb \
"

# Override default Nitrogen8MM u-boot configuration
UBOOT_DTB_NAME = "imx8mm-dwe.dtb"
UBOOT_CONFIG[sd] = "dwe_1gch1_defconfig"
```

## layers/meta-resin-artik/conf/layer.conf
```bitbake
BBPATH .= ":${LAYERDIR}"

BBFILES += "${LAYERDIR}/recipes-*/*/*.bb \
            ${LAYERDIR}/recipes-*/*/*.bbappend"

BBFILE_COLLECTIONS += "resin-artik"
BBFILE_PATTERN_resin-artik := "^${LAYERDIR}/"
BBFILE_PRIORITY_resin-artik = "1337"
```

## layers/meta-resin-fsl-arm/conf/layer.conf
```bitbake
BBPATH .= ":${LAYERDIR}"

BBFILES += "${LAYERDIR}/recipes-*/*/*.bb \
            ${LAYERDIR}/recipes-*/*/*.bbappend"

BBFILE_COLLECTIONS += "resin-fsl-arm"
BBFILE_PATTERN_resin-fsl-arm := "^${LAYERDIR}/"
BBFILE_PRIORITY_resin-fsl-arm = "1337"

LAYERSERIES_COMPAT_resin-fsl-arm = "sumo"

MACHINE_ESSENTIAL_EXTRA_RDEPENDS_remove_nitrogen6x = " kernel-image"
MACHINE_ESSENTIAL_EXTRA_RDEPENDS_remove_solidrun-imx6 = " kernel-image"

PREFERRED_PROVIDER_u-boot_nitrogen6x = "u-boot-boundary"
PREFERRED_PROVIDER_virtual/bootloader_nitrogen6x = "u-boot-boundary"
```
