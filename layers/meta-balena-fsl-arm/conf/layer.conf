## layers/meta-balena-fsl-arm/conf/layer.conf
```bitbake
BBPATH .= ":${LAYERDIR}"

BBFILES += "${LAYERDIR}/recipes-*/*/*.bb \
            ${LAYERDIR}/recipes-*/*/*.bbappend"

BBFILE_COLLECTIONS += "balena-fsl-arm"
BBFILE_PATTERN_balena-fsl-arm := "^${LAYERDIR}/"
BBFILE_PRIORITY_balena-fsl-arm = "1337"

LAYERSERIES_COMPAT_balena-fsl-arm = "kirkstone"

MACHINE_ESSENTIAL_EXTRA_RDEPENDS:remove:nitrogen6x = " kernel-image"
MACHINE_ESSENTIAL_EXTRA_RDEPENDS:remove:solidrun-imx6 = " kernel-image"

PREFERRED_PROVIDER_u-boot:nitrogen6x = "u-boot-boundary"
PREFERRED_PROVIDER_virtual/bootloader:nitrogen6x = "u-boot-boundary"

PREFERRED_PROVIDER_u-boot:nitrogen8mm = "u-boot-boundary"
PREFERRED_PROVIDER_virtual/bootloader:nitrogen8mm = "u-boot-boundary"

PREFERRED_PROVIDER_u-boot:imx8mm-lpddr4-evk = "u-boot-imx"
PREFERRED_PROVIDER_virtual/bootloader:imx8mm-lpddr4-evk = "u-boot-imx"

BBMASK += "meta-boundary/recipes-boundary/images"
BBMASK += "meta-solidrun-arm-imx6/recipes-multimedia/gstreamer/gstreamer1.0-plugins-bad_1.12.%.bbappend"
BBMASK += "meta-boundary/recipes-graphics/wayland/weston_4.0.0.imx.bbappend"
BBMASK += "meta-boundary/recipes-qt/"
BBMASK += "meta-boundary/classes/image_types_boundary.bbclass"

ACCEPT_FSL_EULA = "1"

SERIAL_CONSOLES:nitrogen8mm = "115200;ttymxc1"

KERNEL_DEVICETREE:append:nitrogen8mm = " \
        freescale/imx8mm-nitrogen8mm_rev2.dtb \
        freescale/imx8mm-nitrogen8mm_rev2-m4.dtb \
"

IMX_DEFAULT_BSP:imx8mm-lpddr4-evk = "nxp"

SERIAL_CONSOLES:imx8mm-lpddr4-evk = "115200;ttymxc1"

FIRMWARE_COMPRESSION:nitrogen8mm ?= "1"
FIRMWARE_COMPRESSION:imx8mm-lpddr4-evk ?= "1"

# Temporarily removed until the solidrun upstream repo adds honister support: https://github.com/SolidRun/meta-solidrun-solidsense/issues/2
BBMASK += "meta-balena-fsl-arm/recipes-bsp/u-boot/u-boot-solidsense-imx6_%.bbappend"

# Reduces the size of packages shared between the main rootfs and the initramfs.
CFLAGS:append:pn-busybox:nitrogen8mm = " -Os"
CFLAGS:append:pn-bash:nitrogen8mm = " -Os"
CFLAGS:append:pn-coreutils:nitrogen8mm = " -Os"
CFLAGS:append:pn-util-linux:nitrogen8mm = " -Os"
CFLAGS:append:pn-e2fsprogs:nitrogen8mm = " -Os"
CFLAGS:append:pn-dosfstools:nitrogen8mm = " -Os"
CFLAGS:append:pn-parted:nitrogen8mm = " -Os"
CFLAGS:append:pn-mtools:nitrogen8mm = " -Os"
CFLAGS:append:pn-shadow:nitrogen8mm = " -Os"
CFLAGS:append:pn-kmod:nitrogen8mm = " -Os"
CFLAGS:append:pn-xz:nitrogen8mm = " -Os"
CFLAGS:append:pn-zlib:nitrogen8mm = " -Os"
CFLAGS:append:pn-zstd:nitrogen8mm = " -Os"
CFLAGS:append:pn-openssl:nitrogen8mm = " -Os"
CFLAGS:append:pn-gmp:nitrogen8mm = " -Os"
CFLAGS:append:pn-libcap:nitrogen8mm = " -Os"
CFLAGS:append:pn-libseccomp:nitrogen8mm = " -Os"
CFLAGS:append:pn-libbsd:nitrogen8mm = " -Os"
CFLAGS:append:pn-libmd:nitrogen8mm = " -Os"
CFLAGS:append:pn-libxcrypt:nitrogen8mm = " -Os"
CFLAGS:append:pn-onig:nitrogen8mm = " -Os"
CFLAGS:append:pn-ncurses:nitrogen8mm = " -Os"
CFLAGS:append:pn-readline:nitrogen8mm = " -Os"
CFLAGS:append:pn-acl:nitrogen8mm = " -Os"
CFLAGS:append:pn-attr:nitrogen8mm = " -Os"
CFLAGS:append:pn-jq:nitrogen8mm = " -Os"
```
